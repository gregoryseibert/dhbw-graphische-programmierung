ASAP2_VERSION 1 41
/begin PROJECT TirePressureMonitor_PC_2_ "Generated by ETAS from Project TirePressureMonitor_PC_2_"
/begin HEADER "" VERSION "000" PROJECT_NO ASD /end HEADER
/begin MODULE TirePressureMonitor_PC_2_ "Generated by ETAS ASCET7 from Project: TirePressureMonitor_PC_2_"
/begin IF_DATA E_TARGET
 /begin SOURCE "Task0" 3 /* period */ 10 QP_BLOB 1 /end SOURCE
 /begin TP_BLOB /* programm id */ 2432712526 /* target id */ 7 0 2 0 /end TP_BLOB
/end IF_DATA
/begin MOD_PAR "" VERSION "000" ADDR_EPK 0x0 EPK "" SUPPLIER "ETAS GmbH" CUSTOMER "xxx" CUSTOMER_NO "000" USER "xxx" PHONE_NO "000" ECU "PC" CPU_TYPE "PCx86" NO_OF_INTERFACES 1 /end MOD_PAR
/begin MOD_COMMON "Common definitions" BYTE_ORDER MSB_LAST ALIGNMENT_BYTE 1 ALIGNMENT_WORD 2 ALIGNMENT_LONG 4 ALIGNMENT_FLOAT32_IEEE 4 ALIGNMENT_FLOAT64_IEEE 8 /end MOD_COMMON
/begin CHARACTERISTIC components.TirePressureMonitor.deviationThreshold "" VALUE 0x434000 STANDARD_VALUE_R32 0.0 esdl_ident -3.4028234663852886E+38 3.4028234663852886E+38 /end CHARACTERISTIC
/begin CHARACTERISTIC components.TirePressureMonitor.vFrontLeft "" VALUE 0x434004 STANDARD_VALUE_R32 0.0 esdl_ident -3.4028234663852886E+38 3.4028234663852886E+38 /end CHARACTERISTIC
/begin CHARACTERISTIC components.TirePressureMonitor.vFrontRight "" VALUE 0x434008 STANDARD_VALUE_R32 0.0 esdl_ident -3.4028234663852886E+38 3.4028234663852886E+38 /end CHARACTERISTIC
/begin CHARACTERISTIC components.TirePressureMonitor.vRearLeft "" VALUE 0x43400C STANDARD_VALUE_R32 0.0 esdl_ident -3.4028234663852886E+38 3.4028234663852886E+38 /end CHARACTERISTIC
/begin CHARACTERISTIC components.TirePressureMonitor.vRearRight "" VALUE 0x434010 STANDARD_VALUE_R32 0.0 esdl_ident -3.4028234663852886E+38 3.4028234663852886E+38 /end CHARACTERISTIC
/begin CHARACTERISTIC components.TirePressureMonitor.integratorComponent.kI "" VALUE 0x434014 STANDARD_VALUE_R32 0.0 esdl_ident -3.4028234663852886E+38 3.4028234663852886E+38 /end CHARACTERISTIC
/begin MEASUREMENT components.TirePressureMonitor.distanceFrontLeft "" FLOAT32_IEEE esdl_ident 1 100.0 -3.4028234663852886E+38 3.4028234663852886E+38 ECU_ADDRESS 0x451024 /end MEASUREMENT
/begin MEASUREMENT components.TirePressureMonitor.distanceFrontRight "" FLOAT32_IEEE esdl_ident 1 100.0 -3.4028234663852886E+38 3.4028234663852886E+38 ECU_ADDRESS 0x451028 /end MEASUREMENT
/begin MEASUREMENT components.TirePressureMonitor.distanceRearRight "" FLOAT32_IEEE esdl_ident 1 100.0 -3.4028234663852886E+38 3.4028234663852886E+38 ECU_ADDRESS 0x451030 /end MEASUREMENT
/begin MEASUREMENT components.TirePressureMonitor.distanceRearLeft "" FLOAT32_IEEE esdl_ident 1 100.0 -3.4028234663852886E+38 3.4028234663852886E+38 ECU_ADDRESS 0x45102C /end MEASUREMENT
/begin MEASUREMENT components.TirePressureMonitor.averageDistance "" FLOAT32_IEEE esdl_ident 1 100.0 -3.4028234663852886E+38 3.4028234663852886E+38 ECU_ADDRESS 0x451020 /end MEASUREMENT
/begin MEASUREMENT components.TirePressureMonitor.detectedTirePressureDeviation "" UBYTE esdl_ident 1 100.0 0 1 ECU_ADDRESS 0x451034 BIT_MASK 0x1 /end MEASUREMENT
/begin MEASUREMENT components.TirePressureMonitor.integratorComponent.memory "" FLOAT32_IEEE esdl_ident 1 100.0 -3.4028234663852886E+38 3.4028234663852886E+38 ECU_ADDRESS 0x451038 /end MEASUREMENT
/begin COMPU_METHOD esdl_ident "" RAT_FUNC /* format */ "%12.4" /* unit */ "" /* coeffs */ COEFFS 0 1 0 0 0 1 /end COMPU_METHOD
/begin FUNCTION TirePressureMonitor_PC_2_ ""
 /begin SUB_FUNCTION components.TirePressureMonitor components.Average components.DeltaTimeService components.DeviationDetector /end SUB_FUNCTION
/end FUNCTION
/begin FUNCTION components.TirePressureMonitor ""
 /begin DEF_CHARACTERISTIC components.TirePressureMonitor.deviationThreshold components.TirePressureMonitor.vFrontLeft components.TirePressureMonitor.vFrontRight components.TirePressureMonitor.vRearLeft components.TirePressureMonitor.vRearRight /end DEF_CHARACTERISTIC
 /begin LOC_MEASUREMENT components.TirePressureMonitor.averageDistance components.TirePressureMonitor.detectedTirePressureDeviation components.TirePressureMonitor.distanceFrontLeft components.TirePressureMonitor.distanceFrontRight components.TirePressureMonitor.distanceRearLeft components.TirePressureMonitor.distanceRearRight /end LOC_MEASUREMENT
 /begin SUB_FUNCTION components.TirePressureMonitor.integratorComponent /end SUB_FUNCTION
/end FUNCTION
/begin FUNCTION components.TirePressureMonitor.integratorComponent "" /begin DEF_CHARACTERISTIC components.TirePressureMonitor.integratorComponent.kI /end DEF_CHARACTERISTIC /begin LOC_MEASUREMENT components.TirePressureMonitor.integratorComponent.memory /end LOC_MEASUREMENT /end FUNCTION
/begin FUNCTION components.Average "" /end FUNCTION
/begin FUNCTION components.DeltaTimeService "" /end FUNCTION
/begin FUNCTION components.DeviationDetector "" /end FUNCTION
/begin RECORD_LAYOUT STANDARD_VALUE_R32 /* value */ FNC_VALUES 1 FLOAT32_IEEE COLUMN_DIR DIRECT /end RECORD_LAYOUT
/begin GROUP TirePressureMonitor_PC_2_ "" ROOT
 /begin SUB_GROUP components.TirePressureMonitor components.Average components.DeltaTimeService components.DeviationDetector /end SUB_GROUP
/end GROUP
/begin GROUP components.TirePressureMonitor ""
 /begin REF_CHARACTERISTIC components.TirePressureMonitor.deviationThreshold components.TirePressureMonitor.vFrontLeft components.TirePressureMonitor.vFrontRight components.TirePressureMonitor.vRearLeft components.TirePressureMonitor.vRearRight /end REF_CHARACTERISTIC
 /begin REF_MEASUREMENT components.TirePressureMonitor.averageDistance components.TirePressureMonitor.detectedTirePressureDeviation components.TirePressureMonitor.distanceFrontLeft components.TirePressureMonitor.distanceFrontRight components.TirePressureMonitor.distanceRearLeft components.TirePressureMonitor.distanceRearRight /end REF_MEASUREMENT
 /begin SUB_GROUP components.TirePressureMonitor.integratorComponent /end SUB_GROUP
/end GROUP
/begin GROUP components.TirePressureMonitor.integratorComponent "" /begin REF_CHARACTERISTIC components.TirePressureMonitor.integratorComponent.kI /end REF_CHARACTERISTIC /begin REF_MEASUREMENT components.TirePressureMonitor.integratorComponent.memory /end REF_MEASUREMENT /end GROUP
/begin GROUP components.Average "" /end GROUP
/begin GROUP components.DeltaTimeService "" /end GROUP
/begin GROUP components.DeviationDetector "" /end GROUP
/end MODULE
/end PROJECT
