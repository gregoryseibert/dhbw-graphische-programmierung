ASAP2_VERSION 1 41
/begin PROJECT IntegratorTest_PC "Generated by ETAS from Project IntegratorTest_PC"
/begin HEADER "" VERSION "000" PROJECT_NO ASD /end HEADER
/begin MODULE IntegratorTest_PC "Generated by ETAS ASCET7 from Project: IntegratorTest_PC"
/begin IF_DATA E_TARGET
 /begin SOURCE "Task0" 3 /* period */ 10 QP_BLOB 1 /end SOURCE
 /begin TP_BLOB /* programm id */ 1677744938 /* target id */ 7 0 2 0 /end TP_BLOB
/end IF_DATA
/begin MOD_PAR "" VERSION "000" ADDR_EPK 0x0 EPK "" SUPPLIER "ETAS GmbH" CUSTOMER "xxx" CUSTOMER_NO "000" USER "xxx" PHONE_NO "000" ECU "PC" CPU_TYPE "PCx86" NO_OF_INTERFACES 1 /end MOD_PAR
/begin MOD_COMMON "Common definitions" BYTE_ORDER MSB_LAST ALIGNMENT_BYTE 1 ALIGNMENT_WORD 2 ALIGNMENT_LONG 4 ALIGNMENT_FLOAT32_IEEE 4 ALIGNMENT_FLOAT64_IEEE 8 /end MOD_COMMON
/begin CHARACTERISTIC lib.IntegratorTest.integrate_dTVal "" VALUE 0x434060 STANDARD_VALUE_R32 0.0 esdl_ident -3.4028234663852886E+38 3.4028234663852886E+38 /end CHARACTERISTIC
/begin CHARACTERISTIC lib.IntegratorTest.integrate_inputVal "" VALUE 0x434064 STANDARD_VALUE_R32 0.0 esdl_ident -3.4028234663852886E+38 3.4028234663852886E+38 /end CHARACTERISTIC
/begin CHARACTERISTIC lib.IntegratorTest.tester.kI "" VALUE 0x434068 STANDARD_VALUE_R32 0.0 esdl_ident -3.4028234663852886E+38 3.4028234663852886E+38 /end CHARACTERISTIC
/begin MEASUREMENT lib.IntegratorTest.outVal_return "" /* datatype */ FLOAT32_IEEE esdl_ident /* resolution */ 1 /* accuracy */ 100.0 -3.4028234663852886E+38 3.4028234663852886E+38 ECU_ADDRESS 0x45104C /end MEASUREMENT
/begin MEASUREMENT lib.IntegratorTest.tester.memory "" /* datatype */ FLOAT32_IEEE esdl_ident /* resolution */ 1 /* accuracy */ 100.0 -3.4028234663852886E+38 3.4028234663852886E+38 ECU_ADDRESS 0x451050 /end MEASUREMENT
/begin COMPU_METHOD esdl_ident "" RAT_FUNC /* format */ "%12.4" /* unit */ "" /* coeffs */ COEFFS 0 1 0 0 0 1 /end COMPU_METHOD
/begin FUNCTION IntegratorTest_PC "" /begin SUB_FUNCTION lib.IntegratorTest /end SUB_FUNCTION /end FUNCTION
/begin FUNCTION lib.IntegratorTest ""
 /begin DEF_CHARACTERISTIC lib.IntegratorTest.integrate_dTVal lib.IntegratorTest.integrate_inputVal /end DEF_CHARACTERISTIC
 /begin LOC_MEASUREMENT lib.IntegratorTest.outVal_return /end LOC_MEASUREMENT
 /begin SUB_FUNCTION lib.IntegratorTest.tester /end SUB_FUNCTION
/end FUNCTION
/begin FUNCTION lib.IntegratorTest.tester "" /begin DEF_CHARACTERISTIC lib.IntegratorTest.tester.kI /end DEF_CHARACTERISTIC /begin LOC_MEASUREMENT lib.IntegratorTest.tester.memory /end LOC_MEASUREMENT /end FUNCTION
/begin RECORD_LAYOUT STANDARD_VALUE_R32 /* value */ FNC_VALUES 1 FLOAT32_IEEE COLUMN_DIR DIRECT /end RECORD_LAYOUT
/begin GROUP IntegratorTest_PC "" ROOT /begin SUB_GROUP lib.IntegratorTest /end SUB_GROUP /end GROUP
/begin GROUP lib.IntegratorTest ""
 /begin REF_CHARACTERISTIC lib.IntegratorTest.integrate_dTVal lib.IntegratorTest.integrate_inputVal /end REF_CHARACTERISTIC
 /begin REF_MEASUREMENT lib.IntegratorTest.outVal_return /end REF_MEASUREMENT
 /begin SUB_GROUP lib.IntegratorTest.tester /end SUB_GROUP
/end GROUP
/begin GROUP lib.IntegratorTest.tester "" /begin REF_CHARACTERISTIC lib.IntegratorTest.tester.kI /end REF_CHARACTERISTIC /begin REF_MEASUREMENT lib.IntegratorTest.tester.memory /end REF_MEASUREMENT /end GROUP
/end MODULE
/end PROJECT
