ASAP2_VERSION 1 41
/begin PROJECT SystemTest_PC "Generated by ETAS from Project SystemTest_PC"
/begin HEADER "" VERSION "000" PROJECT_NO ASD /end HEADER
/begin MODULE SystemTest_PC "Generated by ETAS ASCET7 from Project: SystemTest_PC"
/begin IF_DATA E_TARGET
 /begin SOURCE "Task0" 3 /* period */ 10 QP_BLOB 1 /end SOURCE
 /begin TP_BLOB /* programm id */ 3439352658 /* target id */ 7 0 2 0 /end TP_BLOB
/end IF_DATA
/begin MOD_PAR "" VERSION "000" ADDR_EPK 0x0 EPK "" SUPPLIER "ETAS GmbH" CUSTOMER "xxx" CUSTOMER_NO "000" USER "xxx" PHONE_NO "000" ECU "PC" CPU_TYPE "PCx86" NO_OF_INTERFACES 1 /end MOD_PAR
/begin MOD_COMMON "Common definitions" BYTE_ORDER MSB_LAST ALIGNMENT_BYTE 1 ALIGNMENT_WORD 2 ALIGNMENT_LONG 4 ALIGNMENT_FLOAT32_IEEE 4 ALIGNMENT_FLOAT64_IEEE 8 /end MOD_COMMON
/begin CHARACTERISTIC components.SystemTest.parameterANormal "" VALUE 0x435028 STANDARD_VALUE_S32 0.0 esdl_ident -2147483648 2147483647 /end CHARACTERISTIC
/begin CHARACTERISTIC components.SystemTest.parameterCNormal "" VALUE 0x435030 STANDARD_VALUE_S32 0.0 esdl_ident -2147483648 2147483647 /end CHARACTERISTIC
/begin CHARACTERISTIC components.SystemTest.parameterMNormal "" VALUE 0x435038 STANDARD_VALUE_S32 0.0 esdl_ident -2147483648 2147483647 /end CHARACTERISTIC
/begin CHARACTERISTIC components.SystemTest.parameterADeviation "" VALUE 0x435024 STANDARD_VALUE_S32 0.0 esdl_ident -2147483648 2147483647 /end CHARACTERISTIC
/begin CHARACTERISTIC components.SystemTest.parameterCDeviation "" VALUE 0x43502C STANDARD_VALUE_S32 0.0 esdl_ident -2147483648 2147483647 /end CHARACTERISTIC
/begin CHARACTERISTIC components.SystemTest.parameterMDeviation "" VALUE 0x435034 STANDARD_VALUE_S32 0.0 esdl_ident -2147483648 2147483647 /end CHARACTERISTIC
/begin CHARACTERISTIC components.SystemTest.baseSignal "" VALUE 0x435020 STANDARD_VALUE_R32 0.0 esdl_ident -3.4028234663852886E+38 3.4028234663852886E+38 /end CHARACTERISTIC
/begin CHARACTERISTIC components.SystemTest.recalibrate "" VALUE 0x43503C STANDARD_VALUE_U8 0.0 esdl_ident 0 1 BIT_MASK 0x1 /end CHARACTERISTIC
/begin CHARACTERISTIC components.TirePressureMonitor.deviationThreshold "" VALUE 0x435040 STANDARD_VALUE_R32 0.0 esdl_ident -3.4028234663852886E+38 3.4028234663852886E+38 /end CHARACTERISTIC
/begin CHARACTERISTIC components.TirePressureMonitor.Integrator_instance.kI "" VALUE 0x435044 STANDARD_VALUE_R32 0.0 esdl_ident -3.4028234663852886E+38 3.4028234663852886E+38 /end CHARACTERISTIC
/begin CHARACTERISTIC components.TirePressureMonitor.Integrator_instance_2.kI "" VALUE 0x435048 STANDARD_VALUE_R32 0.0 esdl_ident -3.4028234663852886E+38 3.4028234663852886E+38 /end CHARACTERISTIC
/begin CHARACTERISTIC components.TirePressureMonitor.Integrator_instance_3.kI "" VALUE 0x43504C STANDARD_VALUE_R32 0.0 esdl_ident -3.4028234663852886E+38 3.4028234663852886E+38 /end CHARACTERISTIC
/begin CHARACTERISTIC components.TirePressureMonitor.Integrator_instance_4.kI "" VALUE 0x435050 STANDARD_VALUE_R32 0.0 esdl_ident -3.4028234663852886E+38 3.4028234663852886E+38 /end CHARACTERISTIC
/begin MEASUREMENT components.SystemTest.RandomNumberGenerator_instance.memory "" UWORD esdl_ident 1 100.0 0 1000 ECU_ADDRESS 0x435000 /end MEASUREMENT
/begin MEASUREMENT components.SystemTest.RandomNumberGenerator_instance_2.memory "" UWORD esdl_ident 1 100.0 0 1000 ECU_ADDRESS 0x435002 /end MEASUREMENT
/begin MEASUREMENT components.SystemTest.RandomNumberGenerator_instance_3.memory "" UWORD esdl_ident 1 100.0 0 1000 ECU_ADDRESS 0x435004 /end MEASUREMENT
/begin MEASUREMENT components.SystemTest.RandomNumberGenerator_instance_4.memory "" UWORD esdl_ident 1 100.0 0 1000 ECU_ADDRESS 0x435006 /end MEASUREMENT
/begin MEASUREMENT components.velocityMessage.vFrontLeft "" FLOAT32_IEEE esdl_ident 1 100.0 -3.4028234663852886E+38 3.4028234663852886E+38 ECU_ADDRESS 0x45208C /end MEASUREMENT
/begin MEASUREMENT components.velocityMessage.vFrontRight "" FLOAT32_IEEE esdl_ident 1 100.0 -3.4028234663852886E+38 3.4028234663852886E+38 ECU_ADDRESS 0x452088 /end MEASUREMENT
/begin MEASUREMENT components.velocityMessage.vRearLeft "" FLOAT32_IEEE esdl_ident 1 100.0 -3.4028234663852886E+38 3.4028234663852886E+38 ECU_ADDRESS 0x452084 /end MEASUREMENT
/begin MEASUREMENT components.velocityMessage.vRearRight "" FLOAT32_IEEE esdl_ident 1 100.0 -3.4028234663852886E+38 3.4028234663852886E+38 ECU_ADDRESS 0x452080 /end MEASUREMENT
/begin MEASUREMENT components.deviationMessage.deviationDetected "" UBYTE esdl_ident 1 100.0 0 1 ECU_ADDRESS 0x452021 BIT_MASK 0x1 /end MEASUREMENT
/begin MEASUREMENT components.deviationMessage.recalibrate "" UBYTE esdl_ident 1 100.0 0 1 ECU_ADDRESS 0x452020 BIT_MASK 0x1 /end MEASUREMENT
/begin MEASUREMENT components.TirePressureMonitor.Integrator_instance.memory "" FLOAT32_IEEE esdl_ident 1 100.0 -3.4028234663852886E+38 3.4028234663852886E+38 ECU_ADDRESS 0x452040 /end MEASUREMENT
/begin MEASUREMENT components.TirePressureMonitor.Integrator_instance_2.memory "" FLOAT32_IEEE esdl_ident 1 100.0 -3.4028234663852886E+38 3.4028234663852886E+38 ECU_ADDRESS 0x452044 /end MEASUREMENT
/begin MEASUREMENT components.TirePressureMonitor.Integrator_instance_3.memory "" FLOAT32_IEEE esdl_ident 1 100.0 -3.4028234663852886E+38 3.4028234663852886E+38 ECU_ADDRESS 0x452048 /end MEASUREMENT
/begin MEASUREMENT components.TirePressureMonitor.Integrator_instance_4.memory "" FLOAT32_IEEE esdl_ident 1 100.0 -3.4028234663852886E+38 3.4028234663852886E+38 ECU_ADDRESS 0x45204C /end MEASUREMENT
/begin MEASUREMENT components.TirePressureMonitor.WarningSOS_instance.sm "" UBYTE esdl_components_WarningSOSStatemachineStates 1 100.0 0 4 ECU_ADDRESS 0x45205B /end MEASUREMENT
/begin MEASUREMENT components.TirePressureMonitor.WarningSOS_instance.deltaTime "" FLOAT32_IEEE esdl_ident 1 100.0 -3.4028234663852886E+38 3.4028234663852886E+38 ECU_ADDRESS 0x452050 /end MEASUREMENT
/begin MEASUREMENT components.TirePressureMonitor.WarningSOS_instance.time "" FLOAT32_IEEE esdl_ident 1 100.0 -3.4028234663852886E+38 3.4028234663852886E+38 ECU_ADDRESS 0x452054 /end MEASUREMENT
/begin MEASUREMENT components.TirePressureMonitor.WarningSOS_instance.counterSignalShort "" UBYTE esdl_ident 1 100.0 0 3 ECU_ADDRESS 0x452059 /end MEASUREMENT
/begin MEASUREMENT components.TirePressureMonitor.WarningSOS_instance.counterSignalLong "" UBYTE esdl_ident 1 100.0 0 3 ECU_ADDRESS 0x452058 /end MEASUREMENT
/begin MEASUREMENT components.TirePressureMonitor.WarningSOS_instance.lampIsOn "" UBYTE esdl_ident 1 100.0 0 1 ECU_ADDRESS 0x45205A BIT_MASK 0x1 /end MEASUREMENT
/begin MEASUREMENT components.TirePressureMonitor.WarningSOS_instance_2.sm "" UBYTE esdl_components_WarningSOSStatemachineStates 1 100.0 0 4 ECU_ADDRESS 0x452067 /end MEASUREMENT
/begin MEASUREMENT components.TirePressureMonitor.WarningSOS_instance_2.deltaTime "" FLOAT32_IEEE esdl_ident 1 100.0 -3.4028234663852886E+38 3.4028234663852886E+38 ECU_ADDRESS 0x45205C /end MEASUREMENT
/begin MEASUREMENT components.TirePressureMonitor.WarningSOS_instance_2.time "" FLOAT32_IEEE esdl_ident 1 100.0 -3.4028234663852886E+38 3.4028234663852886E+38 ECU_ADDRESS 0x452060 /end MEASUREMENT
/begin MEASUREMENT components.TirePressureMonitor.WarningSOS_instance_2.counterSignalShort "" UBYTE esdl_ident 1 100.0 0 3 ECU_ADDRESS 0x452065 /end MEASUREMENT
/begin MEASUREMENT components.TirePressureMonitor.WarningSOS_instance_2.counterSignalLong "" UBYTE esdl_ident 1 100.0 0 3 ECU_ADDRESS 0x452064 /end MEASUREMENT
/begin MEASUREMENT components.TirePressureMonitor.WarningSOS_instance_2.lampIsOn "" UBYTE esdl_ident 1 100.0 0 1 ECU_ADDRESS 0x452066 BIT_MASK 0x1 /end MEASUREMENT
/begin MEASUREMENT components.distanceMessage.distanceFrontLeft "" FLOAT32_IEEE esdl_ident 1 100.0 -3.4028234663852886E+38 3.4028234663852886E+38 ECU_ADDRESS 0x452030 /end MEASUREMENT
/begin MEASUREMENT components.distanceMessage.distanceFrontRight "" FLOAT32_IEEE esdl_ident 1 100.0 -3.4028234663852886E+38 3.4028234663852886E+38 ECU_ADDRESS 0x45202C /end MEASUREMENT
/begin MEASUREMENT components.distanceMessage.distanceRearLeft "" FLOAT32_IEEE esdl_ident 1 100.0 -3.4028234663852886E+38 3.4028234663852886E+38 ECU_ADDRESS 0x452028 /end MEASUREMENT
/begin MEASUREMENT components.distanceMessage.distanceRearRight "" FLOAT32_IEEE esdl_ident 1 100.0 -3.4028234663852886E+38 3.4028234663852886E+38 ECU_ADDRESS 0x452024 /end MEASUREMENT
/begin MEASUREMENT components.distanceMessage.averageDistance "" FLOAT32_IEEE esdl_ident 1 100.0 -3.4028234663852886E+38 3.4028234663852886E+38 ECU_ADDRESS 0x452034 /end MEASUREMENT
/begin COMPU_METHOD esdl_ident "" RAT_FUNC /* format */ "%12.4" /* unit */ "" /* coeffs */ COEFFS 0 1 0 0 0 1 /end COMPU_METHOD
/begin COMPU_METHOD esdl_components_WarningSOSStatemachineStates "" TAB_VERB /* format */ "%12.4" /* unit */ "" /* compu_tab_ref */ COMPU_TAB_REF esdl_components_WarningSOSStatemachineStates_vtab /end COMPU_METHOD
/begin COMPU_VTAB esdl_components_WarningSOSStatemachineStates_vtab "" TAB_VERB /* number value pairs */ 5 0 "Initial" 4 "ShortSignal" 2 "LampOff" 1 "End" 3 "LongSignal" /* default value */ DEFAULT_VALUE "Error" /end COMPU_VTAB
/begin FUNCTION SystemTest_PC ""
 /begin SUB_FUNCTION components.SystemTest components.TirePressureMonitor components.Average components.DeviationDetector /end SUB_FUNCTION
/end FUNCTION
/begin FUNCTION components.SystemTest ""
 /begin DEF_CHARACTERISTIC components.SystemTest.parameterANormal components.SystemTest.parameterCNormal components.SystemTest.parameterMNormal components.SystemTest.parameterADeviation components.SystemTest.parameterCDeviation components.SystemTest.parameterMDeviation components.SystemTest.baseSignal components.SystemTest.recalibrate /end DEF_CHARACTERISTIC
 /begin OUT_MEASUREMENT components.deviationMessage.recalibrate components.velocityMessage.vFrontLeft components.velocityMessage.vFrontRight components.velocityMessage.vRearLeft components.velocityMessage.vRearRight /end OUT_MEASUREMENT
 /begin SUB_FUNCTION components.SystemTest.RandomNumberGenerator_instance components.SystemTest.RandomNumberGenerator_instance_2 components.SystemTest.RandomNumberGenerator_instance_3 components.SystemTest.RandomNumberGenerator_instance_4 /end SUB_FUNCTION
/end FUNCTION
/begin FUNCTION components.SystemTest.RandomNumberGenerator_instance ""
 /begin LOC_MEASUREMENT components.SystemTest.RandomNumberGenerator_instance.memory /end LOC_MEASUREMENT
/end FUNCTION
/begin FUNCTION components.SystemTest.RandomNumberGenerator_instance_2 ""
 /begin LOC_MEASUREMENT components.SystemTest.RandomNumberGenerator_instance_2.memory /end LOC_MEASUREMENT
/end FUNCTION
/begin FUNCTION components.SystemTest.RandomNumberGenerator_instance_3 ""
 /begin LOC_MEASUREMENT components.SystemTest.RandomNumberGenerator_instance_3.memory /end LOC_MEASUREMENT
/end FUNCTION
/begin FUNCTION components.SystemTest.RandomNumberGenerator_instance_4 ""
 /begin LOC_MEASUREMENT components.SystemTest.RandomNumberGenerator_instance_4.memory /end LOC_MEASUREMENT
/end FUNCTION
/begin FUNCTION components.TirePressureMonitor "" /begin DEF_CHARACTERISTIC components.TirePressureMonitor.deviationThreshold /end DEF_CHARACTERISTIC
 /begin IN_MEASUREMENT components.deviationMessage.recalibrate components.velocityMessage.vFrontLeft components.velocityMessage.vFrontRight components.velocityMessage.vRearLeft components.velocityMessage.vRearRight /end IN_MEASUREMENT
 /begin OUT_MEASUREMENT components.deviationMessage.deviationDetected components.distanceMessage.averageDistance components.distanceMessage.distanceFrontLeft components.distanceMessage.distanceFrontRight components.distanceMessage.distanceRearLeft components.distanceMessage.distanceRearRight /end OUT_MEASUREMENT
 /begin SUB_FUNCTION components.TirePressureMonitor.Integrator_instance components.TirePressureMonitor.Integrator_instance_2 components.TirePressureMonitor.Integrator_instance_3 components.TirePressureMonitor.Integrator_instance_4 components.TirePressureMonitor.WarningSOS_instance components.TirePressureMonitor.WarningSOS_instance_2 /end SUB_FUNCTION
/end FUNCTION
/begin FUNCTION components.TirePressureMonitor.Integrator_instance "" /begin DEF_CHARACTERISTIC components.TirePressureMonitor.Integrator_instance.kI /end DEF_CHARACTERISTIC /begin LOC_MEASUREMENT components.TirePressureMonitor.Integrator_instance.memory /end LOC_MEASUREMENT /end FUNCTION
/begin FUNCTION components.TirePressureMonitor.Integrator_instance_2 "" /begin DEF_CHARACTERISTIC components.TirePressureMonitor.Integrator_instance_2.kI /end DEF_CHARACTERISTIC
 /begin LOC_MEASUREMENT components.TirePressureMonitor.Integrator_instance_2.memory /end LOC_MEASUREMENT
/end FUNCTION
/begin FUNCTION components.TirePressureMonitor.Integrator_instance_3 "" /begin DEF_CHARACTERISTIC components.TirePressureMonitor.Integrator_instance_3.kI /end DEF_CHARACTERISTIC
 /begin LOC_MEASUREMENT components.TirePressureMonitor.Integrator_instance_3.memory /end LOC_MEASUREMENT
/end FUNCTION
/begin FUNCTION components.TirePressureMonitor.Integrator_instance_4 "" /begin DEF_CHARACTERISTIC components.TirePressureMonitor.Integrator_instance_4.kI /end DEF_CHARACTERISTIC
 /begin LOC_MEASUREMENT components.TirePressureMonitor.Integrator_instance_4.memory /end LOC_MEASUREMENT
/end FUNCTION
/begin FUNCTION components.TirePressureMonitor.WarningSOS_instance ""
 /begin LOC_MEASUREMENT components.TirePressureMonitor.WarningSOS_instance.counterSignalLong components.TirePressureMonitor.WarningSOS_instance.counterSignalShort components.TirePressureMonitor.WarningSOS_instance.deltaTime components.TirePressureMonitor.WarningSOS_instance.lampIsOn components.TirePressureMonitor.WarningSOS_instance.sm components.TirePressureMonitor.WarningSOS_instance.time /end LOC_MEASUREMENT
/end FUNCTION
/begin FUNCTION components.TirePressureMonitor.WarningSOS_instance_2 ""
 /begin LOC_MEASUREMENT components.TirePressureMonitor.WarningSOS_instance_2.counterSignalLong components.TirePressureMonitor.WarningSOS_instance_2.counterSignalShort components.TirePressureMonitor.WarningSOS_instance_2.deltaTime components.TirePressureMonitor.WarningSOS_instance_2.lampIsOn components.TirePressureMonitor.WarningSOS_instance_2.sm components.TirePressureMonitor.WarningSOS_instance_2.time /end LOC_MEASUREMENT
/end FUNCTION
/begin FUNCTION components.Average "" /end FUNCTION
/begin FUNCTION components.DeviationDetector "" /end FUNCTION
/begin RECORD_LAYOUT STANDARD_VALUE_S32 FNC_VALUES 1 SLONG COLUMN_DIR DIRECT /end RECORD_LAYOUT
/begin RECORD_LAYOUT STANDARD_VALUE_R32 FNC_VALUES 1 FLOAT32_IEEE COLUMN_DIR DIRECT /end RECORD_LAYOUT
/begin RECORD_LAYOUT STANDARD_VALUE_U8 FNC_VALUES 1 UBYTE COLUMN_DIR DIRECT /end RECORD_LAYOUT
/begin GROUP SystemTest_PC "" ROOT
 /begin SUB_GROUP components.SystemTest components.velocityMessage components.deviationMessage components.TirePressureMonitor components.distanceMessage components.Average components.DeviationDetector /end SUB_GROUP
/end GROUP
/begin GROUP components.SystemTest ""
 /begin REF_CHARACTERISTIC components.SystemTest.parameterANormal components.SystemTest.parameterCNormal components.SystemTest.parameterMNormal components.SystemTest.parameterADeviation components.SystemTest.parameterCDeviation components.SystemTest.parameterMDeviation components.SystemTest.baseSignal components.SystemTest.recalibrate /end REF_CHARACTERISTIC
 /begin SUB_GROUP components.SystemTest.RandomNumberGenerator_instance components.SystemTest.RandomNumberGenerator_instance_2 components.SystemTest.RandomNumberGenerator_instance_3 components.SystemTest.RandomNumberGenerator_instance_4 /end SUB_GROUP
/end GROUP
/begin GROUP components.SystemTest.RandomNumberGenerator_instance ""
 /begin REF_MEASUREMENT components.SystemTest.RandomNumberGenerator_instance.memory /end REF_MEASUREMENT
/end GROUP
/begin GROUP components.SystemTest.RandomNumberGenerator_instance_2 ""
 /begin REF_MEASUREMENT components.SystemTest.RandomNumberGenerator_instance_2.memory /end REF_MEASUREMENT
/end GROUP
/begin GROUP components.SystemTest.RandomNumberGenerator_instance_3 ""
 /begin REF_MEASUREMENT components.SystemTest.RandomNumberGenerator_instance_3.memory /end REF_MEASUREMENT
/end GROUP
/begin GROUP components.SystemTest.RandomNumberGenerator_instance_4 ""
 /begin REF_MEASUREMENT components.SystemTest.RandomNumberGenerator_instance_4.memory /end REF_MEASUREMENT
/end GROUP
/begin GROUP components.velocityMessage ""
 /begin REF_MEASUREMENT components.velocityMessage.vFrontLeft components.velocityMessage.vFrontRight components.velocityMessage.vRearLeft components.velocityMessage.vRearRight /end REF_MEASUREMENT
/end GROUP
/begin GROUP components.deviationMessage ""
 /begin REF_MEASUREMENT components.deviationMessage.deviationDetected components.deviationMessage.recalibrate /end REF_MEASUREMENT
/end GROUP
/begin GROUP components.TirePressureMonitor "" /begin REF_CHARACTERISTIC components.TirePressureMonitor.deviationThreshold /end REF_CHARACTERISTIC
 /begin SUB_GROUP components.TirePressureMonitor.Integrator_instance components.TirePressureMonitor.Integrator_instance_2 components.TirePressureMonitor.Integrator_instance_3 components.TirePressureMonitor.Integrator_instance_4 components.TirePressureMonitor.WarningSOS_instance components.TirePressureMonitor.WarningSOS_instance_2 /end SUB_GROUP
/end GROUP
/begin GROUP components.TirePressureMonitor.Integrator_instance "" /begin REF_CHARACTERISTIC components.TirePressureMonitor.Integrator_instance.kI /end REF_CHARACTERISTIC /begin REF_MEASUREMENT components.TirePressureMonitor.Integrator_instance.memory /end REF_MEASUREMENT /end GROUP
/begin GROUP components.TirePressureMonitor.Integrator_instance_2 "" /begin REF_CHARACTERISTIC components.TirePressureMonitor.Integrator_instance_2.kI /end REF_CHARACTERISTIC
 /begin REF_MEASUREMENT components.TirePressureMonitor.Integrator_instance_2.memory /end REF_MEASUREMENT
/end GROUP
/begin GROUP components.TirePressureMonitor.Integrator_instance_3 "" /begin REF_CHARACTERISTIC components.TirePressureMonitor.Integrator_instance_3.kI /end REF_CHARACTERISTIC
 /begin REF_MEASUREMENT components.TirePressureMonitor.Integrator_instance_3.memory /end REF_MEASUREMENT
/end GROUP
/begin GROUP components.TirePressureMonitor.Integrator_instance_4 "" /begin REF_CHARACTERISTIC components.TirePressureMonitor.Integrator_instance_4.kI /end REF_CHARACTERISTIC
 /begin REF_MEASUREMENT components.TirePressureMonitor.Integrator_instance_4.memory /end REF_MEASUREMENT
/end GROUP
/begin GROUP components.TirePressureMonitor.WarningSOS_instance ""
 /begin REF_MEASUREMENT components.TirePressureMonitor.WarningSOS_instance.counterSignalLong components.TirePressureMonitor.WarningSOS_instance.counterSignalShort components.TirePressureMonitor.WarningSOS_instance.deltaTime components.TirePressureMonitor.WarningSOS_instance.lampIsOn components.TirePressureMonitor.WarningSOS_instance.sm components.TirePressureMonitor.WarningSOS_instance.time /end REF_MEASUREMENT
/end GROUP
/begin GROUP components.TirePressureMonitor.WarningSOS_instance_2 ""
 /begin REF_MEASUREMENT components.TirePressureMonitor.WarningSOS_instance_2.counterSignalLong components.TirePressureMonitor.WarningSOS_instance_2.counterSignalShort components.TirePressureMonitor.WarningSOS_instance_2.deltaTime components.TirePressureMonitor.WarningSOS_instance_2.lampIsOn components.TirePressureMonitor.WarningSOS_instance_2.sm components.TirePressureMonitor.WarningSOS_instance_2.time /end REF_MEASUREMENT
/end GROUP
/begin GROUP components.distanceMessage ""
 /begin REF_MEASUREMENT components.distanceMessage.averageDistance components.distanceMessage.distanceFrontLeft components.distanceMessage.distanceFrontRight components.distanceMessage.distanceRearLeft components.distanceMessage.distanceRearRight /end REF_MEASUREMENT
/end GROUP
/begin GROUP components.Average "" /end GROUP
/begin GROUP components.DeviationDetector "" /end GROUP
/end MODULE
/end PROJECT
