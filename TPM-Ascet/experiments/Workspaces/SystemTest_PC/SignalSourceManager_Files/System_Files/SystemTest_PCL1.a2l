ASAP2_VERSION 1 41
/begin PROJECT SystemTest_PC "Generated by ETAS from Project SystemTest_PC"
/begin HEADER "" VERSION "000" PROJECT_NO ASD /end HEADER
/begin MODULE SystemTest_PC "Generated by ETAS ASCET7 from Project: SystemTest_PC"
/begin IF_DATA E_TARGET
 /begin SOURCE "Task0" 3 /* period */ 10 QP_BLOB 1 /end SOURCE
 /begin SOURCE "Task1" 3 /* period */ 1000 QP_BLOB 2 /end SOURCE
 /begin TP_BLOB /* programm id */ 3187686298 /* target id */ 7 0 2 0 /end TP_BLOB
/end IF_DATA
/begin MOD_PAR "" VERSION "000" ADDR_EPK 0x0 EPK "" SUPPLIER "ETAS GmbH" CUSTOMER "xxx" CUSTOMER_NO "000" USER "xxx" PHONE_NO "000" ECU "PC" CPU_TYPE "PCx86" NO_OF_INTERFACES 1 /end MOD_PAR
/begin MOD_COMMON "Common definitions" BYTE_ORDER MSB_LAST ALIGNMENT_BYTE 1 ALIGNMENT_WORD 2 ALIGNMENT_LONG 4 ALIGNMENT_FLOAT32_IEEE 4 ALIGNMENT_FLOAT64_IEEE 8 /end MOD_COMMON
/begin CHARACTERISTIC components.SystemTest.parameterANormal "" VALUE 0x434028 STANDARD_VALUE_S32 0.0 esdl_ident -2147483648 2147483647 /end CHARACTERISTIC
/begin CHARACTERISTIC components.SystemTest.parameterCNormal "" VALUE 0x434030 STANDARD_VALUE_S32 0.0 esdl_ident -2147483648 2147483647 /end CHARACTERISTIC
/begin CHARACTERISTIC components.SystemTest.parameterMNormal "" VALUE 0x434038 STANDARD_VALUE_S32 0.0 esdl_ident -2147483648 2147483647 /end CHARACTERISTIC
/begin CHARACTERISTIC components.SystemTest.parameterADeviation "" VALUE 0x434024 STANDARD_VALUE_S32 0.0 esdl_ident -2147483648 2147483647 /end CHARACTERISTIC
/begin CHARACTERISTIC components.SystemTest.parameterCDeviation "" VALUE 0x43402C STANDARD_VALUE_S32 0.0 esdl_ident -2147483648 2147483647 /end CHARACTERISTIC
/begin CHARACTERISTIC components.SystemTest.parameterMDeviation "" VALUE 0x434034 STANDARD_VALUE_S32 0.0 esdl_ident -2147483648 2147483647 /end CHARACTERISTIC
/begin CHARACTERISTIC components.SystemTest.baseSignal "" VALUE 0x434020 STANDARD_VALUE_R32 0.0 esdl_ident -3.4028234663852886E+38 3.4028234663852886E+38 /end CHARACTERISTIC
/begin CHARACTERISTIC components.SystemTest.recalibrate "" VALUE 0x43403C STANDARD_VALUE_U8 0.0 esdl_ident 0 1 BIT_MASK 0x1 /end CHARACTERISTIC
/begin CHARACTERISTIC components.TirePressureMonitor.deviationThreshold "" VALUE 0x434040 STANDARD_VALUE_R32 0.0 esdl_ident -3.4028234663852886E+38 3.4028234663852886E+38 /end CHARACTERISTIC
/begin CHARACTERISTIC components.TirePressureMonitor.Integrator_instance.kI "" VALUE 0x434044 STANDARD_VALUE_R32 0.0 esdl_ident -3.4028234663852886E+38 3.4028234663852886E+38 /end CHARACTERISTIC
/begin CHARACTERISTIC components.TirePressureMonitor.Integrator_instance_2.kI "" VALUE 0x434048 STANDARD_VALUE_R32 0.0 esdl_ident -3.4028234663852886E+38 3.4028234663852886E+38 /end CHARACTERISTIC
/begin CHARACTERISTIC components.TirePressureMonitor.Integrator_instance_3.kI "" VALUE 0x43404C STANDARD_VALUE_R32 0.0 esdl_ident -3.4028234663852886E+38 3.4028234663852886E+38 /end CHARACTERISTIC
/begin CHARACTERISTIC components.TirePressureMonitor.Integrator_instance_4.kI "" VALUE 0x434050 STANDARD_VALUE_R32 0.0 esdl_ident -3.4028234663852886E+38 3.4028234663852886E+38 /end CHARACTERISTIC
/begin MEASUREMENT components.SystemTest.RandomNumberGenerator_instance.memory "" UWORD esdl_ident 1 100.0 0 1000 ECU_ADDRESS 0x434000 /end MEASUREMENT
/begin MEASUREMENT components.SystemTest.RandomNumberGenerator_instance_2.memory "" UWORD esdl_ident 1 100.0 0 1000 ECU_ADDRESS 0x434002 /end MEASUREMENT
/begin MEASUREMENT components.SystemTest.RandomNumberGenerator_instance_3.memory "" UWORD esdl_ident 1 100.0 0 1000 ECU_ADDRESS 0x434004 /end MEASUREMENT
/begin MEASUREMENT components.SystemTest.RandomNumberGenerator_instance_4.memory "" UWORD esdl_ident 1 100.0 0 1000 ECU_ADDRESS 0x434006 /end MEASUREMENT
/begin MEASUREMENT components.velocityMessage.vFrontLeft "" FLOAT32_IEEE esdl_ident 1 100.0 -3.4028234663852886E+38 3.4028234663852886E+38 ECU_ADDRESS 0x451050 /end MEASUREMENT
/begin MEASUREMENT components.velocityMessage.vFrontRight "" FLOAT32_IEEE esdl_ident 1 100.0 -3.4028234663852886E+38 3.4028234663852886E+38 ECU_ADDRESS 0x45104C /end MEASUREMENT
/begin MEASUREMENT components.velocityMessage.vRearLeft "" FLOAT32_IEEE esdl_ident 1 100.0 -3.4028234663852886E+38 3.4028234663852886E+38 ECU_ADDRESS 0x451048 /end MEASUREMENT
/begin MEASUREMENT components.velocityMessage.vRearRight "" FLOAT32_IEEE esdl_ident 1 100.0 -3.4028234663852886E+38 3.4028234663852886E+38 ECU_ADDRESS 0x451044 /end MEASUREMENT
/begin MEASUREMENT components.deviationMessage.deviationDetected "" UBYTE esdl_ident 1 100.0 0 1 ECU_ADDRESS 0x451021 BIT_MASK 0x1 /end MEASUREMENT
/begin MEASUREMENT components.deviationMessage.recalibrate "" UBYTE esdl_ident 1 100.0 0 1 ECU_ADDRESS 0x451020 BIT_MASK 0x1 /end MEASUREMENT
/begin MEASUREMENT components.TirePressureMonitor.Integrator_instance.memory "" FLOAT32_IEEE esdl_ident 1 100.0 -3.4028234663852886E+38 3.4028234663852886E+38 ECU_ADDRESS 0x451034 /end MEASUREMENT
/begin MEASUREMENT components.TirePressureMonitor.Integrator_instance_2.memory "" FLOAT32_IEEE esdl_ident 1 100.0 -3.4028234663852886E+38 3.4028234663852886E+38 ECU_ADDRESS 0x451038 /end MEASUREMENT
/begin MEASUREMENT components.TirePressureMonitor.Integrator_instance_3.memory "" FLOAT32_IEEE esdl_ident 1 100.0 -3.4028234663852886E+38 3.4028234663852886E+38 ECU_ADDRESS 0x45103C /end MEASUREMENT
/begin MEASUREMENT components.TirePressureMonitor.Integrator_instance_4.memory "" FLOAT32_IEEE esdl_ident 1 100.0 -3.4028234663852886E+38 3.4028234663852886E+38 ECU_ADDRESS 0x451040 /end MEASUREMENT
/begin MEASUREMENT components.distanceMessage.distanceFrontLeft "" FLOAT32_IEEE esdl_ident 1 100.0 -3.4028234663852886E+38 3.4028234663852886E+38 ECU_ADDRESS 0x451030 /end MEASUREMENT
/begin MEASUREMENT components.distanceMessage.distanceFrontRight "" FLOAT32_IEEE esdl_ident 1 100.0 -3.4028234663852886E+38 3.4028234663852886E+38 ECU_ADDRESS 0x45102C /end MEASUREMENT
/begin MEASUREMENT components.distanceMessage.distanceRearLeft "" FLOAT32_IEEE esdl_ident 1 100.0 -3.4028234663852886E+38 3.4028234663852886E+38 ECU_ADDRESS 0x451028 /end MEASUREMENT
/begin MEASUREMENT components.distanceMessage.distanceRearRight "" FLOAT32_IEEE esdl_ident 1 100.0 -3.4028234663852886E+38 3.4028234663852886E+38 ECU_ADDRESS 0x451024 /end MEASUREMENT
/begin COMPU_METHOD esdl_ident "" RAT_FUNC /* format */ "%12.4" /* unit */ "" /* coeffs */ COEFFS 0 1 0 0 0 1 /end COMPU_METHOD
/begin FUNCTION SystemTest_PC ""
 /begin SUB_FUNCTION components.SystemTest components.TirePressureMonitor components.Average components.DeviationDetector /end SUB_FUNCTION
/end FUNCTION
/begin FUNCTION components.SystemTest ""
 /begin DEF_CHARACTERISTIC components.SystemTest.parameterANormal components.SystemTest.parameterCNormal components.SystemTest.parameterMNormal components.SystemTest.parameterADeviation components.SystemTest.parameterCDeviation components.SystemTest.parameterMDeviation components.SystemTest.baseSignal components.SystemTest.recalibrate /end DEF_CHARACTERISTIC
 /begin OUT_MEASUREMENT components.deviationMessage.recalibrate components.velocityMessage.vFrontLeft components.velocityMessage.vFrontRight components.velocityMessage.vRearLeft components.velocityMessage.vRearRight /end OUT_MEASUREMENT
 /begin SUB_FUNCTION components.SystemTest.RandomNumberGenerator_instance components.SystemTest.RandomNumberGenerator_instance_2 components.SystemTest.RandomNumberGenerator_instance_3 components.SystemTest.RandomNumberGenerator_instance_4 /end SUB_FUNCTION
/end FUNCTION
/begin FUNCTION components.SystemTest.RandomNumberGenerator_instance ""
 /begin LOC_MEASUREMENT components.SystemTest.RandomNumberGenerator_instance.memory /end LOC_MEASUREMENT
/end FUNCTION
/begin FUNCTION components.SystemTest.RandomNumberGenerator_instance_2 ""
 /begin LOC_MEASUREMENT components.SystemTest.RandomNumberGenerator_instance_2.memory /end LOC_MEASUREMENT
/end FUNCTION
/begin FUNCTION components.SystemTest.RandomNumberGenerator_instance_3 ""
 /begin LOC_MEASUREMENT components.SystemTest.RandomNumberGenerator_instance_3.memory /end LOC_MEASUREMENT
/end FUNCTION
/begin FUNCTION components.SystemTest.RandomNumberGenerator_instance_4 ""
 /begin LOC_MEASUREMENT components.SystemTest.RandomNumberGenerator_instance_4.memory /end LOC_MEASUREMENT
/end FUNCTION
/begin FUNCTION components.TirePressureMonitor "" /begin DEF_CHARACTERISTIC components.TirePressureMonitor.deviationThreshold /end DEF_CHARACTERISTIC
 /begin IN_MEASUREMENT components.deviationMessage.recalibrate components.velocityMessage.vFrontLeft components.velocityMessage.vFrontRight components.velocityMessage.vRearLeft components.velocityMessage.vRearRight /end IN_MEASUREMENT
 /begin OUT_MEASUREMENT components.deviationMessage.deviationDetected components.distanceMessage.distanceFrontLeft components.distanceMessage.distanceFrontRight components.distanceMessage.distanceRearLeft components.distanceMessage.distanceRearRight /end OUT_MEASUREMENT
 /begin SUB_FUNCTION components.TirePressureMonitor.Integrator_instance components.TirePressureMonitor.Integrator_instance_2 components.TirePressureMonitor.Integrator_instance_3 components.TirePressureMonitor.Integrator_instance_4 /end SUB_FUNCTION
/end FUNCTION
/begin FUNCTION components.TirePressureMonitor.Integrator_instance "" /begin DEF_CHARACTERISTIC components.TirePressureMonitor.Integrator_instance.kI /end DEF_CHARACTERISTIC /begin LOC_MEASUREMENT components.TirePressureMonitor.Integrator_instance.memory /end LOC_MEASUREMENT /end FUNCTION
/begin FUNCTION components.TirePressureMonitor.Integrator_instance_2 "" /begin DEF_CHARACTERISTIC components.TirePressureMonitor.Integrator_instance_2.kI /end DEF_CHARACTERISTIC
 /begin LOC_MEASUREMENT components.TirePressureMonitor.Integrator_instance_2.memory /end LOC_MEASUREMENT
/end FUNCTION
/begin FUNCTION components.TirePressureMonitor.Integrator_instance_3 "" /begin DEF_CHARACTERISTIC components.TirePressureMonitor.Integrator_instance_3.kI /end DEF_CHARACTERISTIC
 /begin LOC_MEASUREMENT components.TirePressureMonitor.Integrator_instance_3.memory /end LOC_MEASUREMENT
/end FUNCTION
/begin FUNCTION components.TirePressureMonitor.Integrator_instance_4 "" /begin DEF_CHARACTERISTIC components.TirePressureMonitor.Integrator_instance_4.kI /end DEF_CHARACTERISTIC
 /begin LOC_MEASUREMENT components.TirePressureMonitor.Integrator_instance_4.memory /end LOC_MEASUREMENT
/end FUNCTION
/begin FUNCTION components.Average "" /end FUNCTION
/begin FUNCTION components.DeviationDetector "" /end FUNCTION
/begin RECORD_LAYOUT STANDARD_VALUE_S32 FNC_VALUES 1 SLONG COLUMN_DIR DIRECT /end RECORD_LAYOUT
/begin RECORD_LAYOUT STANDARD_VALUE_R32 FNC_VALUES 1 FLOAT32_IEEE COLUMN_DIR DIRECT /end RECORD_LAYOUT
/begin RECORD_LAYOUT STANDARD_VALUE_U8 FNC_VALUES 1 UBYTE COLUMN_DIR DIRECT /end RECORD_LAYOUT
/begin GROUP SystemTest_PC "" ROOT
 /begin SUB_GROUP components.SystemTest components.velocityMessage components.deviationMessage components.TirePressureMonitor components.distanceMessage components.Average components.DeviationDetector /end SUB_GROUP
/end GROUP
/begin GROUP components.SystemTest ""
 /begin REF_CHARACTERISTIC components.SystemTest.parameterANormal components.SystemTest.parameterCNormal components.SystemTest.parameterMNormal components.SystemTest.parameterADeviation components.SystemTest.parameterCDeviation components.SystemTest.parameterMDeviation components.SystemTest.baseSignal components.SystemTest.recalibrate /end REF_CHARACTERISTIC
 /begin SUB_GROUP components.SystemTest.RandomNumberGenerator_instance components.SystemTest.RandomNumberGenerator_instance_2 components.SystemTest.RandomNumberGenerator_instance_3 components.SystemTest.RandomNumberGenerator_instance_4 /end SUB_GROUP
/end GROUP
/begin GROUP components.SystemTest.RandomNumberGenerator_instance ""
 /begin REF_MEASUREMENT components.SystemTest.RandomNumberGenerator_instance.memory /end REF_MEASUREMENT
/end GROUP
/begin GROUP components.SystemTest.RandomNumberGenerator_instance_2 ""
 /begin REF_MEASUREMENT components.SystemTest.RandomNumberGenerator_instance_2.memory /end REF_MEASUREMENT
/end GROUP
/begin GROUP components.SystemTest.RandomNumberGenerator_instance_3 ""
 /begin REF_MEASUREMENT components.SystemTest.RandomNumberGenerator_instance_3.memory /end REF_MEASUREMENT
/end GROUP
/begin GROUP components.SystemTest.RandomNumberGenerator_instance_4 ""
 /begin REF_MEASUREMENT components.SystemTest.RandomNumberGenerator_instance_4.memory /end REF_MEASUREMENT
/end GROUP
/begin GROUP components.velocityMessage ""
 /begin REF_MEASUREMENT components.velocityMessage.vFrontLeft components.velocityMessage.vFrontRight components.velocityMessage.vRearLeft components.velocityMessage.vRearRight /end REF_MEASUREMENT
/end GROUP
/begin GROUP components.deviationMessage ""
 /begin REF_MEASUREMENT components.deviationMessage.deviationDetected components.deviationMessage.recalibrate /end REF_MEASUREMENT
/end GROUP
/begin GROUP components.TirePressureMonitor "" /begin REF_CHARACTERISTIC components.TirePressureMonitor.deviationThreshold /end REF_CHARACTERISTIC
 /begin SUB_GROUP components.TirePressureMonitor.Integrator_instance components.TirePressureMonitor.Integrator_instance_2 components.TirePressureMonitor.Integrator_instance_3 components.TirePressureMonitor.Integrator_instance_4 /end SUB_GROUP
/end GROUP
/begin GROUP components.TirePressureMonitor.Integrator_instance "" /begin REF_CHARACTERISTIC components.TirePressureMonitor.Integrator_instance.kI /end REF_CHARACTERISTIC /begin REF_MEASUREMENT components.TirePressureMonitor.Integrator_instance.memory /end REF_MEASUREMENT /end GROUP
/begin GROUP components.TirePressureMonitor.Integrator_instance_2 "" /begin REF_CHARACTERISTIC components.TirePressureMonitor.Integrator_instance_2.kI /end REF_CHARACTERISTIC
 /begin REF_MEASUREMENT components.TirePressureMonitor.Integrator_instance_2.memory /end REF_MEASUREMENT
/end GROUP
/begin GROUP components.TirePressureMonitor.Integrator_instance_3 "" /begin REF_CHARACTERISTIC components.TirePressureMonitor.Integrator_instance_3.kI /end REF_CHARACTERISTIC
 /begin REF_MEASUREMENT components.TirePressureMonitor.Integrator_instance_3.memory /end REF_MEASUREMENT
/end GROUP
/begin GROUP components.TirePressureMonitor.Integrator_instance_4 "" /begin REF_CHARACTERISTIC components.TirePressureMonitor.Integrator_instance_4.kI /end REF_CHARACTERISTIC
 /begin REF_MEASUREMENT components.TirePressureMonitor.Integrator_instance_4.memory /end REF_MEASUREMENT
/end GROUP
/begin GROUP components.distanceMessage ""
 /begin REF_MEASUREMENT components.distanceMessage.distanceFrontLeft components.distanceMessage.distanceFrontRight components.distanceMessage.distanceRearLeft components.distanceMessage.distanceRearRight /end REF_MEASUREMENT
/end GROUP
/begin GROUP components.Average "" /end GROUP
/begin GROUP components.DeviationDetector "" /end GROUP
/end MODULE
/end PROJECT
